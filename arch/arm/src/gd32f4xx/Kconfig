## arch/arm/src/gd32f4xx/Kconfig
```kconfig
#
# For a description of the syntax of this configuration file,
# see the file kconfig-language.txt in the NuttX tools repository.
#

comment "GD32 Configuration Options"


choice
	prompt "GD32 Chip Selection"
	default ARCH_CHIP_GD32F450VK
	depends on ARCH_CHIP_GD32F4XX
###############################################################################
# LQFP100
###############################################################################
config ARCH_CHIP_GD32F450VE
	bool "GD32F450VE LQFP100 512K+0K Flash 256K SRAM"
	select GD32F450
	---help---

config ARCH_CHIP_GD32F450VG
	bool "GD32F450VG LQFP100 512K+2560K Flash 256K SRAM"
	select GD32F450
	---help---

config ARCH_CHIP_GD32F450VI
	bool "GD32F450VI LQFP100 256K+2560K Flash 512K SRAM"
	select GD32F450
	---help---

config ARCH_CHIP_GD32F450VK
	bool "GD32F450VK LQFP100 512K+2560K Flash 256K SRAM"
	select GD32F450
	---help---

###############################################################################
# LQFP144
###############################################################################

###############################################################################
# BGA176
###############################################################################
endchoice


config GD32F405 
	bool
config GD32F407 
	bool
config GD32F450 
	bool

menu "GD32F4xx Peripheral Support"


##### USART Selection
config GD32_USART
	bool
	default n

config GD32_USART0
	bool "USART0"
	default n
	select GD32_USART

config GD32_USART1
	bool "USART1"
	default n
	select GD32_USART

config GD32_USART2
	bool "USART2"
	default n
	select GD32_USART

config GD32_UART3
	bool "UART3"
	default n
	select GD32_USART

config GD32_UART4
	bool "UART4"
	default n
	select GD32_USART

config GD32_USART5
	bool "USART5"
	default n
	select GD32_USART

config GD32_UART6
	bool "UART6"
	default n
	select GD32_USART

config GD32_UART7
	bool "UART7"
	default n
	select GD32_USART

##### USART Configuration
menu "U[S]ART Device Configuration"
	depends on GD32_USART

comment "U[S]ART Devie Configuration"

choice
	prompt "USART0 Driver Configuration"
	default GD32_USART0_SERIALDRIVER
	depends on GD32_USART0

config GD32_USART0_SERIALDRIVER
	bool "Standard serial driver"
	select USART0_SERIALDRIVER

endchoice #
endmenu

endmenu
```
